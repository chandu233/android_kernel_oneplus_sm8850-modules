## oplus/bazel/Kconfig
```kconfig
# SPDX-License-Identifier: GPL-2.0-only

config OPLUS_SYSTEM_KERNEL_QCOM
	bool "OPlus Qualcomm platform support"
	help
	  Enable Qualcomm platform support in OPlus drivers.
```
